## conf/layer.conf
```bitbake
BBPATH .= ":${LAYERDIR}"

BBFILES += "${LAYERDIR}/recipes-*/*/*.bb \
        ${LAYERDIR}/recipes-*/*/*.bbappend"

BBFILE_COLLECTIONS += "jailhouse-layer"
BBFILE_PATTERN_jailhouse-layer = "^${LAYERDIR}/"
BBFILE_PRIORITY_jailhouse-layer = "6"

LAYERDEPENDS_jailhouse-layer = "core"
LAYERSERIES_COMPAT_jailhouse = "dunfell"


LAYERVERSION_jailhouse-layer = "1"
LAYERSERIES_COMPAT_jailhouse-layer = "zeus dunfell"
```
